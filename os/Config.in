## os/Config.in
```kconfig
menu "BigFred hub"

source "$BR2_EXTERNAL_BIGFRED_HUB_PATH/package/Config.in"

endmenu
```

## os/package/Config.in
```kconfig
config BR2_PACKAGE_ALLOY
	bool "Grafana Alloy (prebuilt binary)"
	default n
	help
	  Install a prebuilt Grafana Alloy binary from the overlay path
	  package/alloy/alloy-linux-arm64. Enable when you ship the binary;
	  otherwise install Alloy manually under /usr/bin on the device.
```
